/dts-v1/;
/plugin/;

/ {
    compatible = "brcm,bcm2711";

    fragment@0 {
        target-path = "/";
        __overlay__ {
            #address-cells = <2>;
            #size-cells = <1>;

            simple_uart: simple_uart@fe201000 {
                compatible = "my,simple-uart";
                reg = <0x0 0xfe201000 0x1000>;  // UART0 base address
                status = "okay";
            };
        };
    };
};
